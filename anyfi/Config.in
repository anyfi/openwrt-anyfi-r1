## anyfi/Config.in
```kconfig
menu "Configuration"
	depends on PACKAGE_anyfi-mac

config PACKAGE_anyfi_controller
	string "Controller IP or FQDN"
	help
          The default IP address or fully qualified domain name (FQDN)
          of the controller that should manage the Anyfi.net software.

config PACKAGE_anyfi_controller_key
	string "Controller key"
	help
          The SHA-256 fingerprint of the Controller RSA key.

config PACKAGE_anyfi_optimizer_key
	string "Optimizer key"
	help
          The SHA-256 fingerprint of the Optimizer RSA key.

config PACKAGE_anyfi_enable_radio
	bool "Enable radio"
	default y
	help
          Configure anyfid to register all local Wi-Fi Radios in the Controller
          so that spare radio resources can be used for mobile Wi-Fi services.

config PACKAGE_anyfi_enable_service
	bool "Enable service"
	default y
	help
          Configure myfid to register the local Wi-Fi network as a Service in
          the Controller, making it possible to provide seamless remote access
          to this network.

endmenu
```
